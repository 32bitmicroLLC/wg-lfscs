## buildroot-PoC-framework/package/pfn-mod/Config.in
```kconfig
config BR2_PACKAGE_PFN_MOD
	bool "pfn-mod"
	depends on BR2_LINUX_KERNEL
	help
	  Build and install the pfn_slab_probe out-of-tree kernel module.

	  The module exposes a debugfs interface used to inspect PFN-1
	  and report slab/object information through kmem_dump_obj().

	  The module is installed under /usr/pfn-mod and is intended to be
	  loaded manually with insmod, not automatically via modprobe.
```

## buildroot-PoC-framework/package/umem_poke/Config.in
```kconfig
config BR2_PACKAGE_UMEM_POKE
	bool "umem_poke"
	depends on BR2_LINUX_KERNEL
	depends on BR2_aarch64 || BR2_x86_64
	help
	  Build the umem_poke out-of-tree kernel module and the
	  architecture-specific victim binary.

comment "umem_poke needs a Linux kernel and aarch64 or x86_64"
	depends on !(BR2_aarch64 || BR2_x86_64) || !BR2_LINUX_KERNEL
```
